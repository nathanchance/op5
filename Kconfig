## Kconfig
```kconfig
#
# For a description of the syntax of this configuration file,
# see Documentation/kbuild/kconfig-language.txt.
#
mainmenu "Linux/$ARCH $KERNELVERSION Kernel Configuration"

config SRCARCH
	string
	option env="SRCARCH"

config CUSTOM_ROM
	bool "Custom ROM support"
	default n
	help
	  Enable this for custom ROM specific features/hacks

source "arch/$SRCARCH/Kconfig"
```
